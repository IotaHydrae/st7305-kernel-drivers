/dts-v1/;
/plugin/;

/ {
	compatible = "brcm,bcm2835";

	fragment@0 {
		target = <&spi0>;
		__overlay__ {
			status = "okay";
			tft: st7305@0 {
				#address-cells = <1>;
				#size-cells = <1>;
				// compatible = "sitronix,st7305";
				// compatible = "osptek,ydp154h008-v3";
				// compatible = "osptek,ydp213h001-v3";
				// compatible = "osptek,ydp290h001-v3";
				compatible = "osptek,ydp420h001-v3";
				reg = <0>;
				spi-max-frequency = <50000000>;
				spi-cpol;
				spi-cpha;
				dc-gpios = <&gpio 22 0>;
				reset-gpios = <&gpio 25 0>;
				status = "okay";
			};
		};
	};
};
